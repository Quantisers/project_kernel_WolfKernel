## arch/arm64/hotplug/Kconfig
```kconfig
menu "Custom Hotplug drivers"

config CUSTOM_HOTPLUG
	bool "Enable custom hotplug support"

config ALUCARD_CONTROL
	bool "Alucard"
	depends on CUSTOM_HOTPLUG
	help
	  Known for being battery friendly. Developed by Alucard_24@XDA
config MSM_HOTPLUG
 	bool "MSM hotplug by [Fluxi]"
 	depends on HOTPLUG_CPU
 	default n
 	help
 	  The MSM hotplug driver controls on-/offlining of additional cores based on current cpu load.
 

endmenu
```
